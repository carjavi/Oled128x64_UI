#include <U8g2lib.h>         // Librería para OLED SSD1306 128x64 — instalar desde Library Manager
#include <Button2.h>         // Manejo de botón con debounce — RESPALDO secundario
#include <Wire.h>            // I2C para comunicación con la OLED (incluida con ESP32 core)

// --- Pin del botón PRG ---
const int PIN_BOTON_PRG  = 0;   // Botón PRG integrado en la placa (activo LOW)

// --- Pin del LED integrado ---
const int PIN_LED        = 35;  // LED blanco integrado en la placa Heltec V3

// --- Pines de la pantalla OLED SSD1306 ---
const int PIN_OLED_SDA   = 17;  // Línea de datos I2C para OLED
const int PIN_OLED_SCL   = 18;  // Línea de reloj I2C para OLED
const int PIN_OLED_RST   = 21;  // Reset de la OLED (algunas placas usan -1 si no hay)
const int PIN_VEXT       = 36;  // --- Pin Vext: Alimentación de periféricos externos (OLED, sensores) ---

// Lectura interna de entrada de Bateria de litio
#define VBAT_PIN      1    
#define ADC_CTRL_PIN  37
const float CALIBRATION_FACTOR = (3.7 / 3.392) * 4.9; 

// --- Pantalla OLED 128x64 (U8g2) ---
U8G2_SSD1306_128X64_NONAME_F_HW_I2C oled(U8G2_R0, /* reset=*/ PIN_OLED_RST, /* clock=*/ PIN_OLED_SCL, /* data=*/ PIN_OLED_SDA);

// --- Flags globales para visibilidad de íconos ---
bool show_bluetooth = false;
bool show_usb = false;
bool show_sleep = false;
bool show_wifi = false;
bool show_sd = false;
bool show_lora_label = false;
bool show_charg_battery = false;
bool Show_RTC = false;
bool status_batt = true;             // flag para mostrar batería crítica, True=Si esta conectada | False=No esta conectada

// icono parpadeante de warning
bool show_warning = false;
unsigned long BlinkWarning = 0; // Para controlar el parpadeo del icono
bool warningVisible = true;      // Estado actual del ícono (visible/invisible)

// --- Variables globales para datos ---
String tx_data = "";
String rx_data = "";
String status_info = "";
int i = 0; // Variable para el indicador de carga
int VBat = 0; // Valor de 0 a 100 para el nivel de batería

// --- Para la función charg_battery (detectar si se esta cargando la bateria)---
const int CHARG_BATTERY_PIN = 2;
static unsigned long cb_period_start_time = 0;
static int cb_prev_pin_state = -1; // -1 indica no inicializado
static bool cb_changed_flag = false;
static char cb_last_result = '?';


void setup() {
  // initialize serial communication 
  Serial.begin(115200);

  // --- Configurar el pin del LED ---
  pinMode(PIN_LED, OUTPUT);
  digitalWrite(PIN_LED, LOW);

  // --- Configurar GPIO0 como entrada con pull-up ---
  pinMode(PIN_BOTON_PRG, INPUT_PULLUP);

  // --- Configurar el pin de monitoreo de carga ---
  pinMode(CHARG_BATTERY_PIN, INPUT_PULLUP); // GPIO2 como entrada
  analogReadResolution(12); // para medir el voltaje de la bateria

  // --- OLED setting ---
  pinMode(PIN_VEXT, OUTPUT);
  digitalWrite(PIN_VEXT, LOW);
  delay(100);
  pinMode(PIN_OLED_RST, OUTPUT);
  digitalWrite(PIN_OLED_RST, LOW);
  delay(50);
  digitalWrite(PIN_OLED_RST, HIGH);
  delay(50);
  Wire.begin(PIN_OLED_SDA, PIN_OLED_SCL);
  oled.begin();
  oled.setContrast(255);

  Serial.println("[OLED] Pantalla inicializada correctamente");

  mostrarPantallaBienvenida(); // Mostrar pantalla de bienvenida
  
  AllIcons(); // muestra todos los iconos antes de la pantalla principal
}

const unsigned char carjavi_128x64[] PROGMEM = {
  0x00, 0x00, 0x00, 0x00, 0x00, 0x00, 0x00, 0x00, 0x00, 0x00, 0x00, 0x00, 
  0x00, 0x00, 0x00, 0x00, 0x00, 0x00, 0x00, 0x00, 0x00, 0x00, 0x00, 0x00, 
  0x00, 0x00, 0x00, 0x00, 0x00, 0x00, 0x00, 0x00, 0x00, 0x00, 0x00, 0x00, 
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  0x00, 0x00, 0x00, 0x00, };

// iconos
static const unsigned char image_battery_0_bits[] U8X8_PROGMEM = {0x00,0x00,0x00,0xf0,0xff,0x7f,0x08,0x00,0x80,0x08,0x02,0x82,0x0e,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0x00,0x00};
static const unsigned char image_battery_empty_bits[] U8X8_PROGMEM = {0x00,0x00,0x00,0xf0,0xff,0x7f,0x08,0x00,0x80,0x08,0x00,0x80,0x0e,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0x00,0x00};
static const unsigned char image_bluetooth_bits[] U8X8_PROGMEM = {0x80,0x00,0x40,0x01,0x40,0x02,0x44,0x04,0x48,0x04,0x50,0x02,0x60,0x01,0xc0,0x00,0x60,0x01,0x50,0x02,0x48,0x04,0x44,0x04,0x40,0x02,0x40,0x01,0x80,0x00,0x00,0x00};
static const unsigned char image_ButtonLeft_bits[] U8X8_PROGMEM = {0x08,0x0c,0x0e,0x0f,0x0e,0x0c,0x08};
static const unsigned char image_ButtonRight_bits[] U8X8_PROGMEM = {0x01,0x03,0x07,0x0f,0x07,0x03,0x01};
static const unsigned char image_device_sleep_mode_black_bits[] U8X8_PROGMEM = {0x20,0x00,0x38,0x70,0x1c,0x40,0x1e,0x20,0x8e,0x77,0x0f,0x02,0x0f,0x01,0x8f,0x07,0x1f,0x00,0x1f,0x60,0x7e,0x38,0xfe,0x3f,0xfc,0x1f,0xf8,0x0f,0xe0,0x03,0x00,0x00};
static const unsigned char image_menu_arrow_down_left_bits[] U8X8_PROGMEM = {0x01,0x03,0x07};
static const unsigned char image_menu_arrow_down_right_bits[] U8X8_PROGMEM = {0x04,0x06,0x07};
static const unsigned char image_menu_arrow_up_left_bits[] U8X8_PROGMEM = {0x07,0x03,0x01};
static const unsigned char image_menu_arrow_up_right_bits[] U8X8_PROGMEM = {0x07,0x06,0x04};
static const unsigned char image_operation_warning_bits[] U8X8_PROGMEM = {0x00,0x00,0x80,0x01,0x40,0x02,0x40,0x02,0x20,0x04,0x90,0x09,0x90,0x09,0x88,0x11,0x88,0x11,0x84,0x21,0x02,0x40,0x82,0x41,0x81,0x81,0x01,0x80,0xfe,0x7f,0x00,0x00};
static const unsigned char image_SDcardMounted_bits[] U8X8_PROGMEM = {0xff,0x07,0xff,0x04,0xff,0x07,0xff,0x04,0xff,0x07,0xff,0x04,0xff,0x07,0x67,0x00};
static const unsigned char image_usb_cable_connected_bits[] U8X8_PROGMEM = {0x00,0x00,0x00,0x00,0x00,0x00,0x00,0x03,0xc0,0x07,0x20,0x03,0x10,0x20,0x13,0x60,0xff,0xff,0x43,0x60,0x40,0x20,0x80,0x0c,0x00,0x1f,0x00,0x0c,0x00,0x00,0x00,0x00};
static const unsigned char image_wifi_bits[] U8X8_PROGMEM = {0x80,0x0f,0x00,0x60,0x30,0x00,0x18,0xc0,0x00,0x84,0x0f,0x01,0x62,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0x00,0x00};
static const unsigned char image_calendar_bits[] U8X8_PROGMEM = {0x90,0x04,0x6e,0x3b,0xff,0x7f,0xff,0x7f,0x01,0x40,0x61,0x5b,0x61,0x5b,0x01,0x40,0x6d,0x5b,0x6d,0x5b,0x01,0x40,0x6d,0x43,0x6d,0x43,0x01,0x40,0xfe,0x3f,0x00,0x00};

void loop() {
  static unsigned long lastUpdate = 0;
  const long interval = 100; 

  // Nivel de Battery
  float vbat_float = readBattery();
  VBat = batteryPercentage(vbat_float);

  // --- Simulación de cambio de flags ---
  // Aquí puedes cambiar las flags manualmente o mediante alguna lógica
  // Por ejemplo, activar el bluetooth después de 5 segundos:
  // if (millis() > 5000) show_bluetooth = true;
  
  // --- Simulación de datos dinámicos ---
  // Estos valores se pueden actualizar desde cualquier parte del código
  rx_data = "0";
  tx_data = "0";
  status_info = "Running";

  // Activacion de icons
  show_bluetooth = true;
  show_usb = false;
  show_wifi = true;
  show_lora_label = true;
  show_sd = false;
  show_warning = false;
  show_sleep = false;
  Show_RTC = false;
  
  // Bateria setting
  char charge_status = charg_battery();
  if (charge_status != '?') {
    //rx_data = String(charge_status);
    if (charge_status == 'p'){
      status_batt = false; // status_batt = false --> (La bateria No esta conectada)
    }else{
      status_batt = true; // status_batt = true --> la bateria SI esta conectada 
      if (show_charg_battery) {
        show_usb = true;            // si se esta cargando es porque esta conectado el puerto USB
      }else{
        if (VBat <= 10){
          show_warning = true;
          status_info = "Low Batt";
        }
      }
    }
    //
    if (charge_status == '1'){
      show_charg_battery = true;  // True= si se esta cargando
    }else{
      show_charg_battery = false; // No esta cargado
    } 
  }
  

  // --- Lógica de parpadeo de warning ---
  if (show_warning) {
    if (millis() - BlinkWarning >= 1000) { // Han pasado 1000 ms (1 segundo)
      BlinkWarning = millis();             // Reiniciar el temporizador
      warningVisible = !warningVisible;     // Alternar visibilidad
    }
  } else {
    // Si show_warning es false, asegurarse de que el ícono sea visible
    // la próxima vez que se active.
    warningVisible = true;
  }
  if (millis() - lastUpdate >= interval) {
    lastUpdate = millis();
    drawScreenMain();
  }
}


float readBattery() {
    pinMode(ADC_CTRL_PIN, OUTPUT);
    digitalWrite(ADC_CTRL_PIN, HIGH); 
    delay(5);
    // saca un promedio de 10 mediciones 
    uint32_t sum = 0;
    for (int i = 0; i < 10; i++) {
        sum += analogRead(VBAT_PIN);
        delay(2); 
    }
    uint16_t raw = sum / 10;
    digitalWrite(ADC_CTRL_PIN, LOW);  
    float voltage = (raw / 4095.0) * 3.3; 
    voltage *= CALIBRATION_FACTOR; 
    return voltage;
}

int batteryPercentage(float voltage) { // Interpolacion lineal para mostrar un nivel de bateria de 0 - 100
    if (voltage <= 2.2) return 0;         // menor a 2.2 el modulo se apaga
    if (voltage >= 4.2) return 100;       // mayor a 4.2 bateria full cargada
    return (int)((voltage - 2.2) * 100.0 / (4.2 - 2.2));
}


char charg_battery() {
    /**
    * Retorna '0' ya esta cargada la bateria / funcionamiento normal
    * Retorna '1' esta cargando la bateria
    * Retorna 'p' hay pulsos por parte del integrado de carga (no esta la bateria)
    * Retorna '?' es como un null
    */
    const unsigned long PERIOD_MS = 2000;
    unsigned long now = millis();
    int current_state = digitalRead(CHARG_BATTERY_PIN);

    // --- Inicialización en la primera llamada ---
    if (cb_prev_pin_state == -1) {
        cb_period_start_time = now;
        cb_prev_pin_state = current_state;
        cb_changed_flag = false;
        cb_last_result = '?';
        return '?';
    }
    // --- Detectar cambios durante el período ---
    if (current_state != cb_prev_pin_state) {
        cb_changed_flag = true;
    }
    cb_prev_pin_state = current_state;
    // --- Verificar si ha terminado el período de 3 segundos ---
    if (now - cb_period_start_time >= PERIOD_MS) {
        // --- Determinar el resultado del período ---
        if (cb_changed_flag) {
            cb_last_result = 'p';
        } else {
            cb_last_result = (current_state == HIGH) ? '0' : '1';
        }

        // --- Reiniciar para el próximo período ---
        cb_period_start_time = now; // Reiniciar el temporizador
        cb_prev_pin_state = current_state; // El nuevo estado base
        cb_changed_flag = false; // Resetear el flag de cambios
    }
    return cb_last_result;
}



void drawScreenMain(void) {
  oled.clearBuffer();
  oled.setFontMode(1);
  oled.setBitmapMode(1);
  // --- Ícono de batería ---
  if (status_batt) {
    // Si esta la bateria conectada
    oled.drawXBMP(101, 2, 24, 16, image_battery_empty_bits);  // Comportamiento normal, Dibuja bateria vacia
    //oled.drawFrame(106, 5, 17, 9); // Dibujar marco donde carga
    // Display on LCD
    if (show_charg_battery) {  
      charging(); // Muestra animacion de carga
      // variable global para Incrementar animacion bateria
      i++;
      if (i > 100) {
        i = 0;
      } 
    }else{
      Battery(); //  Indicador de nivel de batería 
    }
  } else {
    // No esta la bateria conectada
    oled.drawXBMP(101, 2, 24, 16, image_battery_0_bits); // Mostrar el ícono de batería crítica
  }
  // --- Íconos condicionales ---
  if (show_bluetooth) {
    oled.drawXBMP(67, 2, 14, 16, image_bluetooth_bits);
  }
  if (show_usb) {
    oled.drawXBMP(2, 1, 16, 16, image_usb_cable_connected_bits);
  }
  if (show_warning && warningVisible) {  // icono parpadea
    oled.drawXBMP(82, 2, 15, 16, image_operation_warning_bits); // ubicacion antigua oled.drawXBMP(79, 35, 16, 16, image_operation_warning_bits);
  }
  if (show_sleep) { // ocupa el mismo ubicación del icono de warning
    oled.drawXBMP(82, 2, 15, 16, image_device_sleep_mode_black_bits);
  }
  if (show_wifi) {
    oled.drawXBMP(48, 2, 19, 16, image_wifi_bits);
  }
  if (show_sd) {
    oled.drawXBMP(114, 39, 11, 8, image_SDcardMounted_bits);
  }

  if (Show_RTC) {
    oled.drawXBMP(97, 35, 15, 16, image_calendar_bits);
  }
  // --- Líneas fijas ---
  oled.drawLine(0, 18, 127, 18);
  oled.drawLine(127, 0, 127, 63);
  oled.drawLine(0, 63, 0, 0);
  oled.drawLine(0, 0, 127, 0);
  oled.drawLine(0, 63, 126, 63);
  oled.drawLine(0, 31, 127, 31);
  oled.drawLine(0, 53, 126, 53);
  // --- Textos fijos ---
  oled.setFont(u8g2_font_helvB08_tr);
  if (show_lora_label) {
      oled.drawStr(21, 13, "LoRa");
  }
  oled.setFont(u8g2_font_haxrcorp4089_tr);
  oled.drawStr(37, 28, "CARJAVI-UI");
  oled.setFont(u8g2_font_6x12_tr);
  oled.drawStr(7, 41, "TX_data:");
  oled.drawStr(7, 50, "RX_data:");
  oled.setFont(u8g2_font_profont11_tr);
  oled.drawStr(9, 62, "Status:");
  // --- Flechas fijas ---
  oled.drawXBMP(122, 59, 3, 3, image_menu_arrow_down_right_bits);
  oled.drawXBMP(2, 59, 3, 3, image_menu_arrow_down_left_bits);
  oled.drawXBMP(122, 33, 3, 3, image_menu_arrow_up_right_bits);
  oled.drawXBMP(2, 33, 3, 3, image_menu_arrow_up_left_bits);
  // ButtonRight
  oled.drawXBMP(29, 21, 4, 7, image_ButtonRight_bits);
  // ButtonLeft
  oled.drawXBMP(92, 21, 4, 7, image_ButtonLeft_bits);
  // --- Datos dinámicos ---
  oled.setFont(u8g2_font_6x12_tr);
  oled.drawStr(60, 41, tx_data.c_str());
  oled.drawStr(60, 50, rx_data.c_str());
  oled.setFont(u8g2_font_profont11_tr);
  oled.drawStr(55, 62, status_info.c_str());
  

  oled.sendBuffer();
}

void AllIcons(void) {
    oled.clearBuffer();
    oled.setFontMode(1);
    oled.setBitmapMode(1);
    // battery_empty
    oled.drawXBMP(101, 2, 24, 16, image_battery_empty_bits);
    // Layer 2
    oled.drawFrame(106, 5, 17, 9);
    // bluetooth
    oled.drawXBMP(67, 2, 14, 16, image_bluetooth_bits);
    // usb_cable_connected
    oled.drawXBMP(2, 1, 16, 16, image_usb_cable_connected_bits);
    // device_sleep_mode_black
    oled.drawXBMP(82, 2, 15, 16, image_device_sleep_mode_black_bits);
    // Layer 7
    oled.drawLine(0, 18, 127, 18);
    // Layer 9
    oled.drawLine(127, 0, 127, 63);
    // Layer 10
    oled.drawLine(0, 63, 0, 0);
    // Layer 10
    oled.drawLine(0, 0, 127, 0);
    // Layer 11
    oled.drawLine(0, 63, 126, 63);
    // wifi
    oled.drawXBMP(48, 2, 19, 16, image_wifi_bits);
    // Layer 13
    oled.setFont(u8g2_font_helvB08_tr);
    oled.drawStr(21, 13, "LoRa");
    // Layer 14
    oled.setFont(u8g2_font_haxrcorp4089_tr);
    oled.drawStr(37, 28, "CARJAVI-UI");
    // Layer 15
    oled.drawLine(0, 31, 127, 31);
    // Layer 16
    oled.setFont(u8g2_font_6x12_tr);
    oled.drawStr(7, 41, "TX_data:");
    // Layer 17
    oled.drawLine(0, 53, 126, 53);
    // Layer 20
    oled.drawStr(7, 50, "RX_data:");
    // Layer 20
    oled.setFont(u8g2_font_profont11_tr);
    oled.drawStr(9, 62, "Status:");
    // menu_arrow_down_right
    oled.drawXBMP(122, 59, 3, 3, image_menu_arrow_down_right_bits);
    // menu_arrow_down_left
    oled.drawXBMP(2, 59, 3, 3, image_menu_arrow_down_left_bits);
    // SDcardMounted
    oled.drawXBMP(114, 39, 11, 8, image_SDcardMounted_bits);
    // ButtonRight
    oled.drawXBMP(29, 21, 4, 7, image_ButtonRight_bits);
    // ButtonLeft
    oled.drawXBMP(92, 21, 4, 7, image_ButtonLeft_bits);
    // menu_arrow_up_right
    oled.drawXBMP(12, 33, 3, 3, image_menu_arrow_up_right_bits);
    // menu_arrow_up_left
    oled.drawXBMP(2, 33, 3, 3, image_menu_arrow_up_left_bits);
    // calendar
    oled.drawXBMP(97, 35, 15, 16, image_calendar_bits);
    // operation_warning
    oled.drawXBMP(79, 35, 16, 16, image_operation_warning_bits);
    //
    oled.sendBuffer();
    delay(600);
}

void charging() {
  // Indica que la bateria se esta cargando
  // Coordenadas del area interior del marco (107, 6) a (121, 12)
  const int INNER_X = 107;
  const int INNER_Y = 6;
  const int INNER_W = 15; // 121 - 107 + 1
  const int INNER_H = 7;  // 12 - 6 + 1
  // Borrar el area interior del indicador para evitar artefactos
  oled.setDrawColor(0); // Color negro para borrar
  oled.drawBox(INNER_X, INNER_Y, INNER_W, INNER_H);
  oled.setDrawColor(1); // Volver a color blanco para dibujar
  // Solo dibujar el fill si i > 0
  if (i > 0) {
    // Calcular el ancho del relleno (de 1 a 15 pixels)
    int fillWidth = map(i, 1, 100, 1, INNER_W);
    fillWidth = constrain(fillWidth, 1, INNER_W);
    // --- Opcion 1: Relleno de izquierda a derecha ---
    // oled.drawBox(INNER_X, INNER_Y, fillWidth, INNER_H);
    // --- Opcion 2: Relleno de derecha a izquierda (como en tu descripcion original) ---
    int startX = INNER_X + (INNER_W - fillWidth); // Ajustar inicio para que crezca hacia la izquierda
    oled.drawBox(startX, INNER_Y, fillWidth, INNER_H);
  }
}

void Battery() {
  // Coordenadas del área interior del marco
  const int INNER_X = 107;
  const int INNER_Y = 6;
  const int INNER_W = 15; // Ancho del área interior
  const int INNER_H = 7;  // Alto del área interior
  // Validar y limitar el valor de entrada
  int level = constrain(VBat, 0, 100);
  // Borrar el área interior del indicador para evitar artefactos
  oled.setDrawColor(0); // Color negro para borrar
  oled.drawBox(INNER_X, INNER_Y, INNER_W, INNER_H);
  oled.setDrawColor(1); // Volver a color blanco para dibujar
  // Solo dibujar el fill si level > 0
  if (level > 0) {
    // Calcular el ancho del relleno (de 1 a 15 píxeles)
    int fillWidth = map(level, 1, 100, 1, INNER_W);
    fillWidth = constrain(fillWidth, 1, INNER_W);
    // --- Relleno de derecha a izquierda ---
    // Calcular la coordenada X de inicio para que crezca desde la derecha
    int startX = INNER_X + (INNER_W - fillWidth);
    oled.drawBox(startX, INNER_Y, fillWidth, INNER_H);
  }
}


void mostrarPantallaBienvenida() {
  oled.clearBuffer();                              // Limpiar buffer de pantalla
  oled.drawXBMP(0, 0, 128, 64, carjavi_128x64);    // Dibuja el logo 
  oled.sendBuffer();                               // Enviar buffer a la pantalla
  delay(2000);
}